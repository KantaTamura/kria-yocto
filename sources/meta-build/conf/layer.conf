## sources/meta-build/conf/layer.conf
```bitbake
# We have a conf and classes directory, add to BBPATH
BBPATH .= ":${LAYERDIR}"

# We have recipes-* directories, add to BBFILES
BBFILES += "${LAYERDIR}/recipes-devtools/qemu/qemu-xilinx-native_%.bbappend \
            ${LAYERDIR}/recipes-devtools/ninja/ninja_%.bbappend \
            "

BBFILE_COLLECTIONS += "build"
BBFILE_PATTERN_build = "^${LAYERDIR}/"
BBFILE_PRIORITY_build = "6"

LAYERDEPENDS_build = "core"
LAYERSERIES_COMPAT_build = "scarthgap"
```
